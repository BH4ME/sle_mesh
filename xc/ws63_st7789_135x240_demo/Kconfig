## xc/ws63_st7789_135x240_demo/Kconfig
```kconfig
config ST7789_SPI_BUS_ID
    int "SPI bus id"
    default 0
    depends on SAMPLE_SUPPORT_WS63_ST7789_135X240

config ST7789_SPI_FREQ_MHZ
    int "SPI clock frequency in MHz"
    default 16
    range 1 32
    depends on SAMPLE_SUPPORT_WS63_ST7789_135X240

config ST7789_TFT_SCL_PIN
    int "TFT SCL / SPI clock GPIO"
    default 7
    depends on SAMPLE_SUPPORT_WS63_ST7789_135X240

config ST7789_TFT_SDA_PIN
    int "TFT SDA / SPI MOSI GPIO"
    default 9
    depends on SAMPLE_SUPPORT_WS63_ST7789_135X240

config ST7789_TFT_MISO_PIN
    int "Optional SPI MISO GPIO, -1 when not wired"
    default -1
    depends on SAMPLE_SUPPORT_WS63_ST7789_135X240

config ST7789_TFT_CS_PIN
    int "TFT CS GPIO"
    default 8
    depends on SAMPLE_SUPPORT_WS63_ST7789_135X240

config ST7789_TFT_DC_PIN
    int "TFT RS/DC GPIO"
    default 10
    depends on SAMPLE_SUPPORT_WS63_ST7789_135X240

config ST7789_TFT_RESET_PIN
    int "TFT RESET GPIO"
    default 6
    depends on SAMPLE_SUPPORT_WS63_ST7789_135X240

config ST7789_TFT_X_OFFSET
    int "ST7789 column offset"
    default 52
    depends on SAMPLE_SUPPORT_WS63_ST7789_135X240
    help
        The common 1.14 inch 135x240 ST7789 panel is centered in a 240x320 RAM.
        Adjust this if the picture is shifted left or right.

config ST7789_TFT_Y_OFFSET
    int "ST7789 row offset"
    default 40
    depends on SAMPLE_SUPPORT_WS63_ST7789_135X240
    help
        Adjust this if the picture is shifted up or down.

config ST7789_COLOR_ORDER_BGR
    bool "Use ST7789 BGR color order"
    default y
    depends on SAMPLE_SUPPORT_WS63_ST7789_135X240

config ST7789_INVERSION_ON
    bool "Enable ST7789 display inversion"
    default y
    depends on SAMPLE_SUPPORT_WS63_ST7789_135X240

config ST7789_FRAME_DELAY_MS
    int "Animation frame delay in ms"
    default 16
    range 0 1000
    depends on SAMPLE_SUPPORT_WS63_ST7789_135X240

config ST7789_TASK_STACK_SIZE
    int "Animation task stack size"
    default 6144
    depends on SAMPLE_SUPPORT_WS63_ST7789_135X240

config ST7789_TASK_PRIO
    int "Animation task priority"
    default 17
    depends on SAMPLE_SUPPORT_WS63_ST7789_135X240
```

## xc/ws63_team_network/Kconfig
```kconfig
config SLE_TEAM_SELF_ID
    int "Fallback self node id"
    default 1
    range 1 254
    help
        Fallback node id used only when WiFi MAC cannot be read. Normal
        builds derive the one-byte route id from the MAC address and choose
        leader/member role at runtime from the built-in WebUI or serial CLI.

config SLE_TEAM_LEADER_ID
    int "Leader node id"
    default 1
    range 1 254

config SLE_TEAM_TEAM_ID
    int "Team id"
    default 1
    range 1 254

config SLE_TEAM_CHANNEL_HASH
    hex "SLE mesh channel hash"
    default 0x11

config SLE_TEAM_UART_BUS
    int "UART bus for terminal CLI"
    default 0

config SLE_TEAM_UART_TXD_PIN
    int "UART TXD pin"
    default 21

config SLE_TEAM_UART_RXD_PIN
    int "UART RXD pin"
    default 22

config SLE_TEAM_LED_PIN
    int "SLE activity LED GPIO"
    default 255
    help
        Set to 255 to disable the legacy single-color activity LED.
        On the v4 schematic, IO2 is CHRG and must not be driven as an LED.

config SLE_TEAM_LED_ACTIVE_LOW
    bool "SLE activity LED is active low"
    default n
    help
        The tested BearPi WS63 blue user LED turns on when GPIO_2 is driven high.

config SLE_TEAM_WS2812_ENABLE
    bool "Enable v4 WS2812 RGB status LED"
    default n
    help
        Enable the v4 single WS2812C RGB LED connected to RGB/IO0.

config SLE_TEAM_WS2812_PIN
    int "WS2812 RGB data GPIO"
    default 0
    depends on SLE_TEAM_WS2812_ENABLE
    help
        On the v4 schematic, RGB is routed to WS63 IO0.

config SLE_TEAM_BUZZER_ENABLE
    bool "Enable v4 buzzer output"
    default n
    help
        Enable BUZZ output on the v4 board.

config SLE_TEAM_BUZZER_PIN
    int "Buzzer GPIO"
    default 14
    depends on SLE_TEAM_BUZZER_ENABLE
    help
        On the v4 schematic, BUZZ is routed to WS63 IO14.

config SLE_TEAM_BUZZER_ACTIVE_HIGH
    bool "Buzzer active high"
    default y
    depends on SLE_TEAM_BUZZER_ENABLE
    help
        Set to y when BUZZER turns on at high level.

config SLE_TEAM_GPS_ENABLE
    bool "Enable v4 GPS UART pinmap"
    default n
    help
        Keep this off when GPS module is not soldered. This option currently
        records/logs UART pin mapping only; NMEA parsing is not enabled yet.

config SLE_TEAM_GPS_UART_BUS
    int "GPS UART bus"
    default 1
    depends on SLE_TEAM_GPS_ENABLE
    help
        On the v4 schematic, GPS uses UART1.

config SLE_TEAM_GPS_UART_TXD_PIN
    int "GPS UART TXD pin"
    default 17
    depends on SLE_TEAM_GPS_ENABLE
    help
        On the v4 schematic, U1TX is routed to WS63 IO17.

config SLE_TEAM_GPS_UART_RXD_PIN
    int "GPS UART RXD pin"
    default 18
    depends on SLE_TEAM_GPS_ENABLE
    help
        On the v4 schematic, U1RX is routed to WS63 IO18.

config SLE_TEAM_ST7789_ENABLE
    bool "Enable v4 ST7789 display"
    default y
    select SPI_SUPPORT_MASTER

config SLE_TEAM_DISPLAY_USE_LVGL
    bool "Use LVGL UI backend for ST7789 display"
    default y
    depends on SLE_TEAM_ST7789_ENABLE
    help
        Enable LVGL-based status/alert rendering on ST7789. Keep this off
        unless your SDK image provides LVGL headers and sources.

config SLE_TEAM_LVGL_DRAW_BUF_LINES
    int "LVGL draw buffer lines for ST7789"
    default 8
    range 8 120
    depends on SLE_TEAM_ST7789_ENABLE && SLE_TEAM_DISPLAY_USE_LVGL
    help
        Number of scanlines used by LVGL partial rendering buffer.
        Higher value improves refresh throughput while increasing RAM usage.
        Keep the default low so SLE central discovery has enough heap.

config SLE_TEAM_ST7789_SPI_BUS
    int "ST7789 SPI bus"
    default 0
    depends on SLE_TEAM_ST7789_ENABLE

config SLE_TEAM_ST7789_SCLK_PIN
    int "ST7789 SCL/SCLK pin"
    default 6
    depends on SLE_TEAM_ST7789_ENABLE

config SLE_TEAM_ST7789_MOSI_PIN
    int "ST7789 SDA/MOSI pin"
    default 8
    depends on SLE_TEAM_ST7789_ENABLE

config SLE_TEAM_ST7789_CS_PIN
    int "ST7789 CS pin"
    default 7
    depends on SLE_TEAM_ST7789_ENABLE

config SLE_TEAM_ST7789_DC_PIN
    int "ST7789 RS/DC pin"
    default 9
    depends on SLE_TEAM_ST7789_ENABLE

config SLE_TEAM_ST7789_RESET_PIN
    int "ST7789 RESET pin"
    default 13
    depends on SLE_TEAM_ST7789_ENABLE

config SLE_TEAM_ST7789_X_OFFSET
    int "ST7789 column offset"
    default 40
    depends on SLE_TEAM_ST7789_ENABLE
    help
        Confirmed v4.4+ landscape 1.14 inch ST7789 module starts at column 40.
        Keep this paired with WIDTH=240, HEIGHT=135, Y_OFFSET=53, MADCTL=0x60.

config SLE_TEAM_ST7789_Y_OFFSET
    int "ST7789 row offset"
    default 53
    depends on SLE_TEAM_ST7789_ENABLE
    help
        Confirmed v4.4+ landscape 1.14 inch ST7789 module starts at row 53.
        Keep this paired with WIDTH=240, HEIGHT=135, X_OFFSET=40, MADCTL=0x60.

config SLE_TEAM_ST7789_WIDTH
    int "ST7789 visible width"
    default 240
    depends on SLE_TEAM_ST7789_ENABLE

config SLE_TEAM_ST7789_HEIGHT
    int "ST7789 visible height"
    default 135
    depends on SLE_TEAM_ST7789_ENABLE

config SLE_TEAM_HEARTBEAT_INTERVAL_S
    int "Heartbeat interval in seconds"
    default 1
    range 1 60

config SLE_TEAM_REPORT_INTERVAL_S
    int "Position report interval in seconds"
    default 5
    range 1 300

config SLE_TEAM_WARN_DISTANCE_M
    int "Warn distance in meters"
    default 50
    range 1 10000

config SLE_TEAM_LOST_DISTANCE_M
    int "Lost distance in meters"
    default 80
    range 1 10000

config SLE_TEAM_HEARTBEAT_TIMEOUT_S
    int "Heartbeat timeout in seconds"
    default 4
    range 1 300

config SLE_TEAM_WIFI_AP_ENABLE
    bool "Enable WiFi SoftAP coexistence smoke test"
    default y
    help
        Start the local WiFi SoftAP and HTTP WebUI used for runtime role
        selection while the SLE team network is running.

config SLE_TEAM_WIFI_AP_AUTO_START
    bool "Auto-start WiFi SoftAP and HTTP WebUI"
    default y
    depends on SLE_TEAM_WIFI_AP_ENABLE
    help
        Keep enabled for v4 unified firmware. The hosted/domain WebUI still
        needs the board HTTP API to be reachable for one-click deployment.

config SLE_TEAM_WIFI_AP_SSID
    string "WiFi SoftAP SSID"
    default "SLE-TEAM-V4"
    depends on SLE_TEAM_WIFI_AP_ENABLE

config SLE_TEAM_WIFI_AP_PSK
    string "WiFi SoftAP password"
    default "123456789"
    depends on SLE_TEAM_WIFI_AP_ENABLE

config SLE_TEAM_WIFI_AP_CHANNEL
    int "WiFi SoftAP channel"
    default 6
    range 1 13
    depends on SLE_TEAM_WIFI_AP_ENABLE

config SLE_TEAM_WIFI_AP_IP_LAST
    int "WiFi SoftAP IP last octet"
    default 1
    range 1 254
    depends on SLE_TEAM_WIFI_AP_ENABLE

config SUPPORT_SLE_PERIPHERAL
    bool
    default y

config SUPPORT_SLE_CENTRAL
    bool
    default y
```
